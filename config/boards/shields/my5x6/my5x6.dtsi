/ {
    chosen {
        zephyr,keyboard-scan = &kscan0;
        zephyr,matrix-transform = &default_transform;
    };

    kscan0: kscan {
        compatible = "zmk,kscan-gpio-matrix";
        label = "KSCAN";

        row-gpios = <&gpio0 2 GPIO_ACTIVE_LOW>,   // Row 0 (adjust pins!)
                    <&gpio0 3 GPIO_ACTIVE_LOW>,
                    <&gpio0 4 GPIO_ACTIVE_LOW>,
                    <&gpio0 5 GPIO_ACTIVE_LOW>,
                    <&gpio0 6 GPIO_ACTIVE_LOW>;

        col-gpios = <&gpio0 7 GPIO_ACTIVE_HIGH>,  // Col 0
                    <&gpio0 8 GPIO_ACTIVE_HIGH>,
                    <&gpio0 9 GPIO_ACTIVE_HIGH>,
                    <&gpio0 10 GPIO_ACTIVE_HIGH>,
                    <&gpio1 15 GPIO_ACTIVE_HIGH>,
                    <&gpio1 14 GPIO_ACTIVE_HIGH>;

        diode-direction = "col-to-row";  // Common for most ortho PCBs (diodes point from col to row)
    };

    default_transform: matrix_transform {
        compatible = "zmk,matrix-transform";
        rows = <5>;
        columns = <6>;
        map = <
            0  1  2  3  4  5
            6  7  8  9 10 11
           12 13 14 15 16 17
           18 19 20 21 22 23
           24 25 26 27 28 29
        >;
    };
};
